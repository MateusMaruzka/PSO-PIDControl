# file: STCubeGenerated.ioc
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Mcu.Family=STM32F0
Mcu.Name=STM32F051R8Tx
Mcu.Package=LQFP64
ProjectManager.HeapSize=0x200
ProjectManager.StackSize=0x400
ProjectManager.TargetToolchain=MDK-ARM V5
board=custom

// file: Src/main.c
/* USER CODE BEGIN Header */
/**
  ******************************************************************************
  * @file           : main.c
  * @brief          : Main program body
  ******************************************************************************
  * @attention
  *
  * <h2><center>&copy; Copyright (c) 2020 STMicroelectronics.
  * All rights reserved.</center></h2>
  *
  * This software component is licensed by ST under BSD 3-Clause license,
  * the "License"; You may not use this file except in compliance with the
  * License. You may obtain a copy of the License at:
  *                        opensource.org/licenses/BSD-3-Clause
  *
  ******************************************************************************
  */
/* USER CODE END Header */

#include "main.h"

/* USER CODE BEGIN Includes */

#include "arm_math.h"

#include <stdlib.h>

/* USER CODE END Includes */

/* USER CODE BEGIN PD */

#define NDIM 2
#define SWARM 10

#define ITER_MAX 50
/* USER CODE END PD */

void SystemClock_Config(void);
/* USER CODE BEGIN PFP */

float genRandomNumber(void); // ???

void fillVector(float *vector, unsigned int len);

float esfera(float x, float y);

unsigned int argmin(float *vector, unsigned int len);

/* USER CODE END PFP */

/* USER CODE BEGIN 0 */

float genRandomNumber(void){
	//static int i = 0;
	//return i++;
	return (float)rand() / (float)RAND_MAX - 0.5;
}

void fillVector(float *vector, unsigned int len){

	for(int i = 0; i < len; i++){

		*(vector+i) = genRandomNumber();

	}

}

float esfera(float x, float y){

	return x*x + y*y;

}

unsigned int argmin(float *vector, unsigned int len){

	unsigned int idx = 0;
	float min = 0;

	for(unsigned int i = 0; i < len; i++){
		if (*(vector+i) < min){
			idx = i;
		}
	}

	return idx;
}

void updateVelocity(arm_matrix_instance_f32 X,
										arm_matrix_instance_f32 V,
										arm_matrix_instance_f32 pBest,
										float32_t *gBest,
										uint32_t ndim){

	// v = v*w + c1*r1(pbest-x) + c2*r2(gbest - x)

}
/* USER CODE END 0 */

int main(void)
{

  /* MCU Configuration--------------------------------------------------------*/

  /* Reset of all peripherals, Initializes the Flash interface and the Systick. */
  HAL_Init();

  /* Configure the system clock */
  SystemClock_Config();

  /* Initialize all configured peripherals */
  /* USER CODE BEGIN 2 */

	// Swarm`s position and velicity
	float32_t x[SWARM][NDIM],
						v[SWARM][NDIM],
						fitness[SWARM],
						fitBest[SWARM],
						pBest[SWARM][NDIM],
						aux[SWARM][NDIM];

	// Initialize the matrices
	fillVector((float32_t *)x, NDIM*SWARM);
	fillVector((float32_t *)v, NDIM*SWARM);

	float32_t c1 = 4, c2 = 4;

	// pBest recebe a posicao do enxame
	arm_copy_f32((const float32_t *)x, (float32_t *)pBest, NDIM*SWARM);

	arm_matrix_instance_f32 X, V, FITNESS, PBEST, AUX, FITBEST;

	arm_mat_init_f32(&X, SWARM, NDIM, (float32_t *)x);
	arm_mat_init_f32(&V, SWARM, NDIM, (float32_t *)v);

	arm_mat_init_f32(&FITNESS, SWARM, 1, fitness);
	arm_mat_init_f32(&FITBEST, SWARM, 1, fitBest);

	arm_mat_init_f32(&PBEST, SWARM, NDIM, (float32_t *)pBest);
	arm_mat_init_f32(&AUX, SWARM,NDIM, (float32_t *)aux);

	for(unsigned int i = 0; i < SWARM; i++){
		arm_power_f32((float32_t *)(x+i), NDIM, fitness+i);
	}

	arm_mat_scale_f32(&FITNESS, 1.0, &FITBEST);

	// Função Esfera implementada de outra maneira

	float32_t fitgBest;
	uint32_t idx_gb = 0;
	arm_min_f32(fitBest, SWARM, &fitgBest, &idx_gb);

	for(int i = 0; i < ITER_MAX; i++){

		// Calculando a velocidade de cada partícula
		arm_mat_scale_f32(&V, 0.5, &V);

		arm_mat_sub_f32(&PBEST, &X, &AUX);

		arm_mat_scale_f32(&AUX, 0.5, &AUX);

		arm_mat_add_f32(&V, &AUX, &V);

		for(unsigned int j = 0; j < SWARM; j++){
			arm_sub_f32(pBest+idx_gb*NDIM, x+j, aux+j, NDIM);
			//arm_power_f32((float32_t *)(x+i), NDIM, aux+i);
		}

		arm_mat_scale_f32(&AUX, 0.5, &AUX);

		arm_mat_add_f32(&V, &AUX, &V);

		// Fim calculo velocidade

		// Incrementa posicao
		arm_mat_add_f32(&X, &V, &X);

		// Função Esfera implementada de outra maneira
		for(int k = 0; k < SWARM; k++){
			arm_power_f32((float32_t *)(x+k), NDIM, fitness+k);
		}

		// Atualiza pbest
		for(unsigned int l = 0; l < SWARM; l++){

			if(fitness[l] <  fitBest[l] || (int)fitBest[l] == -1){

				fitBest[l] = fitness[l];
				arm_copy_f32(pBest + l*NDIM, x+l*NDIM, NDIM);

			}

		}
		// Encontra gbest
		arm_min_f32(fitBest, SWARM, &fitgBest, &idx_gb);

	}

  /* USER CODE END 2 */

  /* Infinite loop */
  while (1) {
  }
}

void SystemClock_Config(void)
{
  RCC_OscInitTypeDef RCC_OscInitStruct = {0};
  RCC_ClkInitTypeDef RCC_ClkInitStruct = {0};

  /** Initializes the CPU, AHB and APB busses clocks
  */
  RCC_OscInitStruct.OscillatorType = RCC_OSCILLATORTYPE_HSI;
  RCC_OscInitStruct.HSIState = RCC_HSI_ON;
  RCC_OscInitStruct.HSICalibrationValue = RCC_HSICALIBRATION_DEFAULT;
  RCC_OscInitStruct.PLL.PLLState = RCC_PLL_NONE;
  if (HAL_RCC_OscConfig(&RCC_OscInitStruct) != HAL_OK)
  {
    Error_Handler();
  }
  /** Initializes the CPU, AHB and APB busses clocks
  */
  RCC_ClkInitStruct.ClockType = RCC_CLOCKTYPE_HCLK|RCC_CLOCKTYPE_SYSCLK
                              |RCC_CLOCKTYPE_PCLK1;
  RCC_ClkInitStruct.SYSCLKSource = RCC_SYSCLKSOURCE_HSI;
  RCC_ClkInitStruct.AHBCLKDivider = RCC_SYSCLK_DIV1;
  RCC_ClkInitStruct.APB1CLKDivider = RCC_HCLK_DIV1;

  if (HAL_RCC_ClockConfig(&RCC_ClkInitStruct, FLASH_LATENCY_0) != HAL_OK)
  {
    Error_Handler();
  }
}

void Error_Handler(void)
{
}

/************************ (C) COPYRIGHT STMicroelectronics *****END OF FILE****/
